## config/boards/shields/lalapadgen2/Kconfig.defconfig
```kconfig
if SHIELD_LALAPADGEN2_LEFT

config ZMK_SPLIT_ROLE_CENTRAL
    default y

config ZMK_SPLIT_BLE_CENTRAL_PERIPHERALS
    default 1

endif

# 共通の設定（左手・右手両方に適用）
if SHIELD_LALAPADGEN2_LEFT || SHIELD_LALAPADGEN2_RIGHT

config ZMK_KEYBOARD_NAME
    default "LalapadGen2"

config BT_MAX_CONN
    default 5

config ZMK_SPLIT
    default y

endif
```
